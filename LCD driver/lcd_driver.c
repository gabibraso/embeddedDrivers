/*
* lcd_driver.c
*
* Created: 7/31/2018 10:24:50 AM
*  Author: gabriel.brasoveanu
*/

#include "spi_driver.h"
#include "lcd_driver.h"
#include <avr/io.h>


static const uint8_t Font[] = {
	0x00, 0x00, 0x00, 0x00, 0x00,
	0x3E, 0x5B, 0x4F, 0x5B, 0x3E,
	0x3E, 0x6B, 0x4F, 0x6B, 0x3E,
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	0x00, 0x00, 0x00, 0x00, 0x00,
};



void lcdSendDataByPolling(uint8_t data)
{
	// Put D/C HIGH (sending data)
	*(lcdInit.lcdPort) |= (1<<lcdInit.DCPin);
	// Put SS to LOW (select this device)
	*(spiStruct.spiPort) &= ~(1<<spiStruct.SSPin);
	// Send data
	spiTransmitByPolling(data);
	// Put SS to HIGH (deselect this device)
	*(spiStruct.spiPort) |= (1<<spiStruct.SSPin);
}

void lcdSendCommandByPolling(uint8_t data)
{
	// Put D/C LOW (sending command)
	*(lcdInit.lcdPort) &= ~(1<<lcdInit.DCPin);
	// Put SS to LOW (select this device)
	*(spiStruct.spiPort) &= ~(1<<spiStruct.SSPin);
	// Send data
	spiTransmitByPolling(data);
	// Put SS to HIGH (deselect this device)
	*(spiStruct.spiPort) |= (1<<spiStruct.SSPin);
}

void lcdSendDataByInterrupt(uint8_t *dataToTransmit, uint8_t *dataToReceive, uint8_t numberOfBytes)
{
	// Put D/C HIGH (sending data)
	*(lcdInit.lcdPort) |= (1<<lcdInit.DCPin);
	// Send data
	spiTransmitByInterrupt(dataToTransmit,dataToReceive,numberOfBytes);
}

void lcdSendCommandByInterrupt(uint8_t *dataToTransmit, uint8_t *dataToReceive, uint8_t numberOfBytes)
{
	// Put D/C LOW (sending command)
	*(lcdInit.lcdPort) &= ~(1<<lcdInit.DCPin);
	// Send data
	spiTransmitByInterrupt(dataToTransmit,dataToReceive,numberOfBytes);
	
}

void lcdInitialize(volatile uint8_t *portLcd, unsigned char RSPin, unsigned char DCPin)
{
	lcdInit.lcdPort = portLcd;
	lcdInit.DCPin = DCPin;
	lcdInit.RSPin = RSPin;
	

	//DDR - set DDR and make RS, D/C output pin
	*(lcdInit.lcdPort-1) |= (1<<lcdInit.DCPin) | (1<<lcdInit.DCPin);
	*(lcdInit.lcdPort) &= ~((1<<lcdInit.RSPin) | (1<<lcdInit.DCPin));
	
	
	//Reset the LCD controller
	*(lcdInit.lcdPort) &= ~(1<<lcdInit.RSPin);
	_delay_us(10);
	*(lcdInit.lcdPort) |= (1<<lcdInit.RSPin);
	_delay_ms(120);

	//SLPOUT (11h): Sleep Out ("Sleep Out"  is for "wake")
	//The DC/DC converter is enabled, Internal display oscillator
	//is started, and panel scanning is started.
	
	lcdTxCommands[0] = SLPOUT;
	lcdSendCommandByInterrupt(&lcdTxCommands[0],NULL,1);
	_delay_ms(120);

	
	lcdTxCommands[1] = INVCTR;
	lcdTxData[0] = 0x07; // Frame Inversion in all mode
	//INVCTR (B4h): Display Inversion Control
	lcdSendCommandByInterrupt(&lcdTxCommands[1],NULL,1);
	lcdSendDataByInterrupt(&lcdTxData[0],NULL,1);
	// 0000 0ABC
	// |||| ||||-- NLC: Inversion setting in full Colors partial mode
	// |||| |||         (0=Line Inversion, 1 = Frame Inversion)
	// |||| |||--- NLB: Inversion setting in idle mode
	// |||| ||          (0=Line Inversion, 1 = Frame Inversion)
	// |||| ||---- NLA: Inversion setting in full Colors normal mode
	// |||| |           (0=Line Inversion, 1 = Frame Inversion)
	// |||| |----- Unused: 0


	//COLMOD (3Ah): Interface Pixel Format
	// * This command is used to define the format of RGB picture
	//   data, which is to be transferred via the MCU interface.
	lcdTxCommands[2] = COLMOD;
	lcdTxData[1] = 0x06;// Default: 0x06 => 18-bit/pixel
	lcdSendCommandByInterrupt(&lcdTxCommands[2],NULL,1);
	lcdSendDataByInterrupt(&lcdTxData[1],NULL,1);
	// IFPF[2:0] MCU Interface Color Format
	// IFPF[2:0] | Format
	//      000b | reserved
	//      001b | reserved
	//      010b | reserved
	//      011b | 12-bit/pixel
	//      100b | reserved
	//      101b | 16-bit/pixel
	//      110b | 18-bit/pixel   <<<<<
	//      111b | reserved

	//DISPON (29h): Display On
	// * This command is used to recover from DISPLAY OFF mode. Output
	//   from the Frame Memory is enabled.
	// * This command makes no change of contents of frame memory.
	// * This command does not change any other status.
	// * The delay time between DISPON and DISPOFF needs 120ms at least
	lcdTxCommands[3] = DISPON;
	lcdSendCommandByInterrupt(&lcdTxCommands[3],NULL,1);//Display On
	_delay_ms(1);

	//MADCTL (36h): Memory Data Access Control
	lcdTxCommands[4] = MADCTL;
	lcdTxData[2] = 0xD0;
	lcdSendCommandByInterrupt(&lcdTxCommands[4],NULL,1);
	lcdSendDataByInterrupt(&lcdTxData[2],NULL,1);// YXVL RH--
	// |||| ||||-- Unused: 0
	// |||| ||---- MH: Horizontal Refresh Order
	// |||| |        0 = left to right
	// |||| |        1 = right to left
	// |||| |----- RGB: RGB vs BGR Order
	// ||||          0 = RGB color filter panel
	// ||||          1 = BGR color filter panel
	// ||||------- ML: Vertical Refresh Order
	// |||           0 = top to bottom
	// |||           1 = bottom to top
	// |||-------- MV: Row / Column Exchange
	// ||--------- MX: Column Address Order  <<<<<
	// |---------- MY: Row Address Order
	// MY MX MV
	// 1  0  1 -- right -> down
	// 1  1  0 -- up -> down
	// 0  0  0 -- down -> up
	// 0  1  1 -- left -> down

}

void SetLcdCursor(uint8_t xStart, uint8_t yStart, uint8_t xStop, uint8_t yStop )
{
	lcdTxCommands[5] = CASET;
	lcdTxCommands[6] = RASET;
	lcdTxCommands[7] = RAMWR;
	lcdTxData[3] = xStart;
	lcdTxData[4] = xStop;
	lcdTxData[5] = yStart;
	lcdTxData[6] = yStop;
	lcdTxData[7] = 0x00;
	lcdSendCommandByInterrupt(&lcdTxCommands[5],NULL,1); //Column address set
	//Write the parameters for the "column address set" command
	lcdSendDataByInterrupt(&lcdTxData[5],NULL,1);		//Start MSB = XS[15:8]
	lcdSendDataByInterrupt(&lcdTxData[3],NULL,1);		//Start LSB = XS[ 7:0]
	lcdSendDataByInterrupt(&lcdTxData[5],NULL,1);		//End MSB   = XE[15:8]
	lcdSendDataByInterrupt(&lcdTxData[4],NULL,1);		//End LSB   = XE[ 7:0]
	
	lcdSendCommandByInterrupt(&lcdTxCommands[6],NULL,1); //Row address set
	//Write the parameters for the "row address set" command
	lcdSendDataByInterrupt(&lcdTxData[5],NULL,1);       //Start MSB = YS[15:8]
	lcdSendDataByInterrupt(&lcdTxData[5],NULL,1);		//Start LSB = YS[ 7:0]
	lcdSendDataByInterrupt(&lcdTxData[5],NULL,1);       //End MSB   = YE[15:8]
	lcdSendDataByInterrupt(&lcdTxData[6],NULL,1);       //End LSB   = YE[ 7:0]
	
	//Write the "write data" command to the LCD
	//RAMWR (2Ch): Memory Write
	lcdSendCommandByInterrupt(&lcdTxCommands[7],NULL,1); //write data
}

void fillLCD(uint32_t *color)
{
	register int i;
	SetLcdCursor(0,0,LCD_HEIGHT,LCD_WIDTH);

	//Fill display with a given RGB value
	for (i =0; i < (LCD_WIDTH * LCD_HEIGHT); i++)
	{
		lcdSendDataByInterrupt(color,NULL,3);
	}
}

void drawHorizontalLine(uint8_t x, uint8_t y, uint8_t w, uint32_t *color)
{
	
	SetLcdCursor(x, y, x+w-1, y);
	while(w--)
	{
		lcdSendDataByInterrupt(color,NULL,3);
	}
}

void drawVerticalLine(uint8_t x, uint8_t y, uint8_t h, uint32_t *color)
{
	SetLcdCursor(x, y, x, y+h-1);
	while(h--)
	{
		lcdSendDataByInterrupt(color,NULL,3);
	}
}

void drawRect (uint8_t x, uint8_t y, uint8_t w, uint8_t h, uint32_t *color) {
	drawHorizontalLine(x, y, w, color);
	drawHorizontalLine(x, y+h-1, w, color);
	drawVerticalLine(x, y, h, color);
	drawVerticalLine(x+w-1, y, h, color);
}

void drawPixel(uint8_t x, uint8_t y, uint32_t *color)
{
	SetLcdCursor(x,y,x+1,y+1);
	lcdSendDataByInterrupt(color,NULL,3);
}

void drawCircle(uint8_t xStart, uint8_t yStart, uint8_t r, uint32_t *color)
{
	int8_t f = 1 - r;
	int8_t ddF_x = 1;
	int8_t ddF_y = -2 * r;
	int8_t x = 0;
	int8_t y = r;

	drawPixel(xStart  , yStart+r, color);
	drawPixel(xStart  , yStart-r, color);
	drawPixel(xStart+r, yStart  , color);
	drawPixel(xStart-r, yStart  , color);

	while (x<y) {
		if (f >= 0) {
			y--;
			ddF_y += 2;
			f += ddF_y;
		}
		x++;
		ddF_x += 2;
		f += ddF_x;
		
		drawPixel(xStart + x, yStart + y, color);
		drawPixel(xStart - x, yStart + y, color);
		drawPixel(xStart + x, yStart - y, color);
		drawPixel(xStart - x, yStart - y, color);
		drawPixel(xStart + y, yStart + x, color);
		drawPixel(xStart - y, yStart + x, color);
		drawPixel(xStart + y, yStart - x, color);
		drawPixel(xStart - y, yStart - x, color);
	}
}

void fillRect(uint8_t x, uint8_t y, uint8_t w, uint8_t h, uint32_t *color) {
	
	for (uint8_t i=x; i<x+w; i++) {
		drawVerticalLine(i, y, h, color);
	}
}

void drawCharS(uint8_t x, uint8_t y, char c, uint32_t *textColor, uint32_t *bgColor, uint8_t size){
	uint8_t line; // vertical column of pixels of character in font
	uint8_t i, j;
	
	for (i=0; i<6; i++ ) {
		if (i == 5)
		line = 0x0;
		else
		line = Font[(c*5)+i];
		for (j = 0; j<8; j++) {
			if (line & 0x1) {
				if (size == 1) // default size
				drawPixel(x+i, y+j, textColor);
				else {  // big size
					fillRect(x+(i*size), y+(j*size), size, size, textColor);
				}
				} else if (bgColor != textColor) {
				if (size == 1) // default size
				drawPixel(x+i, y+j, bgColor);
				else {  // big size
					fillRect(x+i*size, y+j*size, size, size, bgColor);
				}
			}
			line >>= 1;
		}
	}
}

uint8_t drawString(uint8_t x, uint8_t y, char *pt, uint32_t *textColor, uint32_t *bgColor, uint8_t characterSize){

	// If the text has reached the maximum point on the Y axis return 0
	// Maximum point on the Y axis is 128 - characterSize*6
	if(characterSize*6+y>128) return 1;
	
	// If the text has reached the maximum point on the X axis return 0
	// Maximum point on the X axis is 128 - characterSize*6*numberOfCharacters
	if(characterSize*6*strlen(pt)+x>128) return 1;
	
	while(*pt){
		// Print first character
		drawCharS(x, y, *pt, textColor, bgColor, characterSize);
		pt++;
		// Move to the next x point
		x = x+characterSize*6;
	}
	return 0;
}



